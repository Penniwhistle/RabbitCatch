
//George Youens [Penniwhistle]
//30th June, 2018
//Started from a Crait tutorial, then changed pretty much everything.

#include <Arduboy2.h>
#include <ArduboyTones.h>
Arduboy2 arduboy;
ArduboyTones sound(arduboy.audio.enabled);
int playerx = 64;
int playery = 32;
//"Lexip" is the name of the rabbit. My friend wanted to name it. She asked whether it was a boy or a girl. I replied with "pixel."
int lexipx = 48;
int lexipy = 12;
int score = 0;
int hiscore = 0;
int ycheck = 0;
int scene = 0;
int timeleft = 60;
int counter = 0;

const unsigned char background[] PROGMEM  = {
  0x89, 0xc4, 0xaa, 0xf1, 0x2a, 0x86, 0xe9, 0x92,
};
const unsigned char backgroundFront[] PROGMEM  = {
  0x42, 0xff, 0x10, 0xff, 0x8, 0x2, 0xff, 0x22,
};
const unsigned char player[] PROGMEM  = {
  0xf8, 0x6, 0x2, 0x5, 0x49, 0xa9, 0x41, 0x1, 0x1, 0x41, 0xa9, 0x49, 0x5, 0x2, 0x6, 0xf8, 0x1f, 0x60, 0x40, 0x80, 0x88, 0x94, 0x94, 0x94, 0x94, 0x94, 0x94, 0x88, 0x80, 0x40, 0x60, 0x1f,
};
const unsigned char lexip[] PROGMEM  = {
  0x00, 0x00, 0x00, 0x80, 0x78, 0x4, 0x78, 0x40, 0x40, 0x78, 0x4, 0x78, 0x80, 0x00, 0x00, 0x00, 0x00, 0x00, 0x00, 0x7, 0x18, 0x23, 0x28, 0x24, 0x24, 0x28, 0x23, 0x18, 0x7, 0x00, 0x00, 0x00,
};
const unsigned char banner1[] PROGMEM  = {
  0xfc, 0xe3, 0x00, 0x00, 0x00, 0xe3, 0xfc, 0xfc, 0x7e, 0xf, 0x3, 0x1,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 0x00,
};
const unsigned char banner2[] PROGMEM  = {
  0x40, 0x80, 0xff, 0xff, 0xff, 0x81, 0x43, 0x2f, 0x7e, 0xfc, 0xfc, 0xe3,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 0x43,
};
const unsigned char banner3[] PROGMEM  = {
  0x40, 0x80, 0xff, 0xff, 0xff, 0xc3, 0x60, 0x20, 0x20, 0x20, 0x41, 0x80,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 0x40,
};
const unsigned char banner4[] PROGMEM  = {
  0x00, 0x00, 0x00, 0x00, 0x00, 0x80, 0x40, 0x20, 0x21, 0x20, 0x40, 0x80,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 0x00,
};
void setup() {
  arduboy.begin();
  arduboy.setFrameRate(60);
  arduboy.clear();
  scene = 3;
}


void loop() {

  if (!arduboy.nextFrame()) {
    return;
  }

  if (scene == 3) {
    counter = counter + 1;
  }

  if (counter == 1) {
    arduboy.drawBitmap(0, 0, banner1, 128, 16, WHITE);
  }
  if (counter == 10) {
    arduboy.drawBitmap(0, 16, banner2, 128, 16, WHITE);
  }
  if (counter == 20) {
    arduboy.drawBitmap(0, 32, banner3, 128, 16, WHITE);
  }
  if (counter == 30) {
    arduboy.drawBitmap(0, 48, banner4, 128, 16, WHITE);
    sound.tone(600, 30, 800, 30, 1400, 50);
  }
  if (counter == 180) {
    scene = 0;
    counter = 2000;
  }

  if (scene == 0) {
    arduboy.clear();
    arduboy.initRandomSeed();
    lexipx = rand() % 113;
    lexipy = rand() % 41 + 8;
    playerx = rand() % 113;
    playery = rand() % 41 + 8;


    arduboy.setCursor(0, 32);
    arduboy.print("Press A to begin");
    arduboy.display();
    if (arduboy.pressed(A_BUTTON) == true) {
      sound.tone(500, 100, 1000, 100);
      scene = 1;

    }
  }

  if (timeleft == -1) {
    arduboy.clear();
    scene = 2;
    arduboy.setCursor(0, 32);
    arduboy.print("Score: ");
    arduboy.print(score);
    arduboy.print("\n");
    arduboy.print("Hiscore: ");
    arduboy.print(hiscore);
    arduboy.print("\n");
    arduboy.print("Press A to play again");
    arduboy.display();
    if (arduboy.pressed(A_BUTTON) == true) {
      timeleft = 60;
      score = 0;
      scene = 1;
      sound.tone(500, 100, 1000, 100);
      counter = 2000;
    }
  }

  arduboy.display();

  if (scene == 1) {

    arduboy.clear();
    for ( int backgroundx = 0; backgroundx < 128; backgroundx = backgroundx + 8 ) {
      for ( int backgroundy = 8; backgroundy < 56; backgroundy = backgroundy + 8 ) {
        arduboy.drawBitmap( backgroundx, backgroundy, background, 8, 8, WHITE );
      }
    }
    for ( int backgroundFrontx = 0; backgroundFrontx < 128; backgroundFrontx = backgroundFrontx + 8 ) {
      for ( int backgroundFronty = 56; backgroundFronty < 64; backgroundFronty = backgroundFronty + 8 ) {
        arduboy.drawBitmap( backgroundFrontx, backgroundFronty, backgroundFront, 8, 8, WHITE );
      }
    }
    //insert collectables here
    arduboy.fillRect(lexipx, lexipy, 16, 16, BLACK);
    arduboy.drawBitmap(lexipx, lexipy, lexip, 16, 16, WHITE);

    if (lexipx == playerx or lexipx == playerx - 1 or lexipx == playerx + 1 or lexipx == playerx - 2 or lexipx == playerx + 2 or lexipx == playerx - 3 or lexipx == playerx + 3) {
      ycheck = 1;
    }

    if (ycheck == 1) {
      if (lexipy == playery or lexipy == playery - 1 or lexipy == playery + 1 or lexipy == playery - 2 or lexipy == playery + 2 or lexipy == playery - 3 or lexipy == playery + 3) {
        lexipx = rand() % 113;
        lexipy = rand() % 41 + 8;
        ycheck = 0;
        score = score + 1;
        sound.tone(800, 200);
      }
      else ycheck = 0;
    }


    //player sprite
    arduboy.fillRect(playerx, playery, 16, 16, BLACK);
    arduboy.drawBitmap(playerx, playery, player, 16, 16, WHITE);


    if (arduboy.pressed(LEFT_BUTTON) and playerx > 0) {
      playerx = playerx - 1;
    }
    if (arduboy.pressed(RIGHT_BUTTON) and playerx < 112) {
      playerx = playerx + 1;
    }
    if (arduboy.pressed(UP_BUTTON) and playery > 8) {
      playery = playery - 1;
    }
    if (arduboy.pressed(DOWN_BUTTON) and playery < 48) {
      playery = playery + 1;
    }

    //score code
    arduboy.print("Score:");
    arduboy.print(score);
    if (score > hiscore) {
      hiscore = score;
    }

    //timer code
    arduboy.setCursor(60, 0);
    arduboy.print("Time:");
    arduboy.print(timeleft);
    counter = counter + 1;
    if (counter == 2060) {
      timeleft = timeleft - 1;
      counter = 2000;
    }

    arduboy.display();

  }
}


